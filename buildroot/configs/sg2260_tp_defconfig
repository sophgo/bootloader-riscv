## buildroot/configs/sg2260_tp_defconfig
```kconfig
BR2_riscv=y
BR2_TOOLCHAIN_BUILDROOT_GLIBC=y
BR2_GCC_VERSION_11_X=y
BR2_TOOLCHAIN_BUILDROOT_CXX=y
BR2_SYSTEM_DHCP="eth0"
# BR2_PACKAGE_IFUPDOWN_SCRIPTS is not set
# BR2_PACKAGE_URANDOM_SCRIPTS is not set
BR2_TARGET_ROOTFS_CPIO=y
BR2_PACKAGE_HOST_E2FSPROGS=y
BR2_PACKAGE_HOST_KMOD=y
BR2_ROOTFS_OVERLAY="./overlay/tp/"
```

## zsbl/drivers/Kconfig
```kconfig
menu "Device Drivers"

source "drivers/serial/Kconfig"
source "drivers/irqchip/Kconfig"
source "drivers/efuse/Kconfig"

endmenu
```

## zsbl/test/Kconfig
```kconfig
menuconfig TEST
	bool "Test Mode"
	help
	enter test mode instead of real firmware function

if TEST
source "test/arch_timer/Kconfig"
source "test/gic/Kconfig"
source "test/fab/Kconfig"
source "test/hello/Kconfig"
endif
```
